/******************************************************************************

                  版权所有 (C), 2008-2018, 杭州信多达电器有限公司

 ******************************************************************************
  文 件 名   : MCU_EEPROM.c
  版 本 号   : V1.0
  作    者   : 钱百静
  生成日期   : 2018年4月29日
  最近修改   :
  功能描述   : STM8内部EEPROM存储
  函数列表   :
              stm8_LockEEPROM
              stm8_ReadFromEEPROM
              stm8_UnlockEEPROM
              stm8_WriteToEEPROM
  修改历史   :
  1.日    期   : 2018年4月29日
    作    者   : 钱百静
    修改内容   : 创建文件

******************************************************************************/

/*----------------------------------------------*
 * 包含头文件                                        *
 *----------------------------------------------*/
#include "MCU_EEPROM.h"
#include "MCU_Hardware.h"

/*----------------------------------------------*
 * 外部变量说明                                       *
 *----------------------------------------------*/

/*----------------------------------------------*
 * 外部函数原型说明                                     *
 *----------------------------------------------*/

/*----------------------------------------------*
 * 内部函数原型说明                                     *
 *----------------------------------------------*/

/*----------------------------------------------*
 * 全局变量                                         *
 *----------------------------------------------*/

/*----------------------------------------------*
 * 模块级变量                                        *
 *----------------------------------------------*/

/*----------------------------------------------*
 * 常量定义                                         *
 *----------------------------------------------*/
const STORAGE_HARDWARE storageHardware =
{
	f_MCU_WriteToEEPROM,
	f_MCU_ReadFromEEPROM
};

/*----------------------------------------------*
 * 宏定义                                          *
 *----------------------------------------------*/
#define STM8_EEPROM_START_ADD 0x4000


/* =========================================================
* 功能描述: stm8解锁EEPROM
* 输     入:
* 返     回: 成功：BOOL_TRUE, 失败:BOOL_FALSE
* 修改历史:
1、2018-3-25 	钱百静 			完成基本功能
=========================================================*/
uchar f_MCU_UnlockEEPROM(void)
{
	uint iCnt = 0;

	FLASH_CR1 |= 0x01;
	if(FLASH_IAPSR & 0x08)
	{
        return true;
	}
	else
	{
		FLASH_DUKR = 0xAE;
		FLASH_DUKR = 0x56;
	}

	while(!(FLASH_IAPSR & 0x08))
	{
		iCnt ++;
		if(iCnt >= 5000)
		{
			return false;
		}
	}
	return true;
}

/* =========================================================
* 功能描述: stm8锁定EEPROM
* 输     入:
* 返     回:
* 修改历史:
1、2018-3-25		钱百静 			完成基本功能
=========================================================*/
void f_MCU_LockEEPROM(void)
{
	FLASH_IAPSR &= (~0x08);
}

/* =========================================================
* 功能描述: 写数据到stm8的内部eeprom
* 输     入: offset:数据写入的相对偏移地址
            numb:写入字节数
            pData:数据指针
* 返     回: 成功：BOOL_TRUE, 失败:BOOL_FALSE
* 修改历史:
1、2018-3-25 	钱百静 			完成基本功能
=========================================================*/
uchar f_MCU_WriteToEEPROM(uint offset, uchar numb, const uchar *pData)
{
	word_32 writeAddr;

	if (numb == 0)
	{
        return false;
	}

	if(f_MCU_UnlockEEPROM())
    {
        writeAddr = STM8_EEPROM_START_ADD + offset;

        while (numb --)
        {
            *((@far uchar*)(writeAddr)) = *pData;
            writeAddr ++;
            pData ++;
        };
        f_MCU_LockEEPROM();

        return true;
    }

    return false;
}

/* =========================================================
* 功能描述: 从stm8的内部eeprom读取数据
* 输     入: offset:数据写入的相对偏移地址
            numb:读出字节数
            pData:数据指针
* 返     回: 成功：BOOL_TRUE, 失败:BOOL_FALSE
* 修改历史:
1、2018-3-25 	钱百静 			完成基本功能
=========================================================*/
void f_MCU_ReadFromEEPROM(uint offset, uchar numb, uchar *pData)
{
	word_32 writeAddr;
	writeAddr = STM8_EEPROM_START_ADD + offset;
	while (numb --)
    {
        *pData = *((@far uchar*)(writeAddr));
        writeAddr ++;
        pData ++;
    };
}

