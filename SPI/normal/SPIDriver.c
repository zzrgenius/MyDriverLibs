/******************************************************************************

                  版权所有 (C), 2008-2018, 杭州信多达电器有限公司

 ******************************************************************************
  文 件 名   : SPIDriver.c
  版 本 号   : V1.0
  作    者   : 钱百静
  生成日期   : 2018年4月21日
  最近修改   :
  功能描述   : SIP总线驱动
  函数列表   :
  修改历史   :
  1.日    期   : 2018年4月21日
    作    者   : 钱百静
    修改内容   : 创建文件

******************************************************************************/

/*----------------------------------------------*
 * 包含头文件                                        *
 *----------------------------------------------*/
#include "SPIDriver.h"
#include "SubFunction.h"
#include "IO_Define.h"

/*----------------------------------------------*
 * 外部变量说明                                       *
 *----------------------------------------------*/

/*----------------------------------------------*
 * 外部函数原型说明                                     *
 *----------------------------------------------*/

/*----------------------------------------------*
 * 内部函数原型说明                                     *
 *----------------------------------------------*/

/*----------------------------------------------*
 * 全局变量                                         *
 *----------------------------------------------*/

/*----------------------------------------------*
 * 模块级变量                                        *
 *----------------------------------------------*/

/*----------------------------------------------*
 * 常量定义                                         *
 *----------------------------------------------*/

/*----------------------------------------------*
 * 宏定义                                          *
 *----------------------------------------------*/
#define SPI_DL_TM 0

/*****************************************************************************
 函 数 名: void f_SPIWriteData(uint sendData, uchar length)
 功能描述  : SPI总线写数据
 输入参数:
 返 回 值: sendData:发送数据;length：发送位数
 注     意: 最多2字节
 
 修改历史:
  1.日    期   : 2018年4月21日
    作    者   : 钱百静
    修改内容    : 新生成函数

*****************************************************************************/
void f_SPIWriteData(uint sendData, uchar length)
{
	schar i;

	for (i = length - 1; i >= 0; i--)
	{
		SPI_SCL = true;
		if ((sendData>>i)&(0x0001))//发送高位
		{
			SPI_SDI = true;
		}
		else
		{
			SPI_SDI = false;
		}
		#if (SPI_DL_TM > 0)
			f_Delay(SPI_DL_TM);
		#endif
		SPI_SCL = false;
		#if (SPI_DL_TM > 0)
			f_Delay(SPI_DL_TM);
		#endif
	}
}

/*****************************************************************************
 函 数 名: uint f_SPIReadData(uchar length)
 功能描述  : 从SPI总线上读取一个字节
 输入参数: length 发送位长度
 返 回 值: 读取数据
 注     意: 最多2字节
 
 修改历史:
  1.日    期   : 2018年4月21日
    作    者   : 钱百静
    修改内容    : 新生成函数

*****************************************************************************/
uint f_SPIReadData(uchar length)
{
    uint getData = 0;
    uchar i;

    for (i = 0; i < length; i++)
    {
    	getData <<= 1;
		SPI_SCL = true;
		#if (SPI_DL_TM > 0)
			f_Delay(SPI_DL_TM);
		#endif
		SPI_SCL = false;
		#if (SPI_DL_TM > 0)
			f_Delay(SPI_DL_TM);
		#endif
		if (SPI_SDO)
		{
			getData |= 0x0001;
		}
    }
    return getData;
}

